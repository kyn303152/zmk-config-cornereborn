## config/west.yml
```yaml
manifest:
  remotes:
    - name: bobobo1618
      url-base: https://github.com/bobobo1618
  projects:
    - name: zephyr
      remote: bobobo1618
      import: app/west.yml
  self:
    path: config
```
